//Code by Aadhitya G

/* Sketch generated by the Arduino IoT Cloud Thing "Untitled"
  https://create.arduino.cc/cloud/things/fd9ae0c3-d3d5-4bcb-9508-b235e7ed2749 

  Arduino IoT Cloud Variables description

  CloudLight L1;
  CloudLight L2;
  CloudLight L3;
  CloudLight L4;
*/

#include "thingProperties.h"

//HardwareSerial Serial2(2);

void setup() {
  pinMode(D4,OUTPUT);
  Serial.begin(9600);
  delay(1500); 

  //Serial2.begin(9600, SERIAL_8N1, SERIAL_FULL, 17);
Serial.begin(9600, SERIAL_8N1);
  // Defined in thingProperties.h
  initProperties();

  // Connect to Arduino IoT Cloud
  ArduinoCloud.begin(ArduinoIoTPreferredConnection);
  
  setDebugMessageLevel(2);
  ArduinoCloud.printDebugInfo();
}

void loop() {
  ArduinoCloud.update();
  // Keep this loop empty! 
  // Adding delays or heavy code here will disconnect the ESP32 from the cloud.
}


/*
  Since L1 is READ_WRITE variable, onL1Change() is
  executed every time a new value is received from IoT Cloud.
*/
void onL1Change()  {
  if (L1 == true) {
    digitalWrite(D4,LOW);
    Serial.print('A');  // Send ON command to LPC2129
    //Serial.println("L1 ON  -> Sent 'A'"); 
  } else {
    Serial.print('a');  // Send OFF command to LPC2129
     digitalWrite(D4,HIGH);
    //Serial.println("L1 OFF -> Sent 'a'"); 
  }
}

/*
  Since L2 is READ_WRITE variable, onL2Change() is
  executed every time a new value is received from IoT Cloud.
*/
void onL2Change()  {
  if (L2 == true) {
    Serial.print('B');  
    //Serial.println("L2 ON  -> Sent 'B'");
  } else {
    Serial.print('b');  
    //Serial.println("L2 OFF -> Sent 'b'");
  }
}

/*
  Since L3 is READ_WRITE variable, onL3Change() is
  executed every time a new value is received from IoT Cloud.
*/
void onL3Change()  {
  if (L3 == true) {
    Serial.print('C');  
    //Serial.println("L3 ON  -> Sent 'C'");
  } else {
    Serial.print('c');  
    //Serial.println("L3 OFF -> Sent 'c'");
  }
}

/*
  Since L4 is READ_WRITE variable, onL4Change() is
  executed every time a new value is received from IoT Cloud.
*/
void onL4Change()  {
  if (L4 == true) {
    Serial.print('D');  
    //Serial.println("L4 ON  -> Sent 'D'");
  } else {
    Serial.print('d');  
    //Serial.println("L4 OFF -> Sent 'd'");
  }
}
